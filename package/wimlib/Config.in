## package/wimlib/Config.in
```kconfig
config BR2_PACKAGE_WIMLIB
	bool "wimlib"
	help
	  Wimlib
	  wimlib is an open source, cross-platform library for creating, extracting, and modifying Windows Imaging (WIM) archives.

	  http://wimlib.net
```
